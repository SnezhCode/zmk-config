## config/west.yml
```yaml
manifest:
  remotes:
    - name: zmkfirmware
      url-base: https://github.com/zmkfirmware
    - name: ergo
      url-base: https://github.com/ergomechstore
  projects:
    - name: zmk
      remote: ergo
      revision: main
      import: app/west.yml
  self:
    path: config
```
